## base_external/package/ldd/Config.in
```kconfig
config BR2_PACKAGE_LDD
    bool "ldd (LWN’s Linux Device Drivers code)"
    help
      Builds & installs the misc-modules and scull from your ldd3 fork.
```
